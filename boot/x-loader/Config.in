## boot/x-loader/Config.in
```kconfig
menuconfig BR2_TARGET_XLOADER
	bool "X-Loader"
	help
	  Build "X-Loader" first stage boot loader

if BR2_TARGET_XLOADER
config BR2_TARGET_XLOADER_BOARDNAME
	string "X-Loader board name"
	help
	  One of X-Loader supported boards to be built.
	  This will be suffixed with _config to meet X-Loader standard naming.

choice
	prompt "X-Loader Version"
	default BR2_TARGET_XLOADER_1_51
	help
	  Select the specific X-Loader version you want to use

config BR2_TARGET_XLOADER_1_51
	bool "1.51"

config BR2_TARGET_XLOADER_1_48
	bool "1.48"

config BR2_TARGET_XLOADER_1_46
	bool "1.46"

endchoice

config BR2_TARGET_XLOADER_VERSION
	string
	default "1.51"		if BR2_TARGET_XLOADER_1_51
	default "1.48"		if BR2_TARGET_XLOADER_1_48
	default "1.46"		if BR2_TARGET_XLOADER_1_46

config BR2_TARGET_XLOADER_EXTRAVERSION
	string "X-Loader Extraversion"
	default ""
	help
	  X-Loader extraversion string

config BR2_TARGET_XLOADER_CUSTOM_PATCH_DIR
	string "custom patch dir"
	help
	  If your board requires custom patches, add the path to the
	  directory containing the patches here. The patches must be
	  named x-loader-<version>-<something>.patch.

	  Most users may leave this empty

endif # BR2_TARGET_XLOADER
```

## configs/beagle_xm_defconfig
```kconfig
BR2_arm=y
BR2_cortex_a8=y
BR2_TOOLCHAIN_EXTERNAL=y
# BR2_TOOLCHAIN_EXTERNAL_DOWNLOAD is not set
BR2_TOOLCHAIN_EXTERNAL_PATH="/opt/CodeSourcery"
# BR2_SOFT_FLOAT is not set
BR2_TARGET_OPTIMIZATION="-pipe -mfpu=neon -ftree-vectorize -mfloat-abi=softfp"
BR2_TARGET_GENERIC_GETTY_PORT="ttyO2"
BR2_TARGET_UBOOT=y
BR2_TARGET_UBOOT_BOARDNAME="omap3_beagle"
BR2_TARGET_UBOOT_EXTRAVERSION="-mg01"
BR2_TARGET_UBOOT_FORMAT_IMG=y
BR2_TARGET_UBOOT_MLO=y
BR2_TARGET_UBOOT_UENV_PARAMETERS=y
BR2_LINUX_KERNEL=y
BR2_LINUX_KERNEL_PATCH="board/beagleboard/xm/kernel-patches/"
BR2_LINUX_KERNEL_USE_CUSTOM_CONFIG=y
BR2_LINUX_KERNEL_CUSTOM_CONFIG_FILE="board/beagleboard/xm/linux-3.2.7.config"
```

## configs/beagle_xm_full_defconfig
```kconfig
BR2_arm=y
BR2_cortex_a8=y
BR2_TOOLCHAIN_EXTERNAL=y
# BR2_TOOLCHAIN_EXTERNAL_DOWNLOAD is not set
BR2_TOOLCHAIN_EXTERNAL_PATH="/opt/CodeSourcery"
# BR2_SOFT_FLOAT is not set
BR2_TARGET_OPTIMIZATION="-pipe -mfpu=neon -ftree-vectorize -mfloat-abi=softfp"
BR2_TARGET_GENERIC_HOSTNAME="beagleboard-xm"
BR2_TARGET_GENERIC_ISSUE="Welcome to BeagleBoard-xM"
BR2_TARGET_GENERIC_GETTY_PORT="ttyO2"
BR2_PACKAGE_BUSYBOX_SHOW_OTHERS=y
BR2_PACKAGE_ALSA_UTILS=y
BR2_PACKAGE_ALSA_UTILS_ALSACONF=y
BR2_PACKAGE_ALSA_UTILS_AMIDI=y
BR2_PACKAGE_ALSA_UTILS_AMIXER=y
BR2_PACKAGE_ALSA_UTILS_APLAY=y
BR2_PACKAGE_ALSA_UTILS_IECSET=y
BR2_PACKAGE_ALSA_UTILS_ACONNECT=y
BR2_PACKAGE_ALSA_UTILS_APLAYMIDI=y
BR2_PACKAGE_ALSA_UTILS_ARECORDMIDI=y
BR2_PACKAGE_ALSA_UTILS_ASEQDUMP=y
BR2_PACKAGE_ALSA_UTILS_ASEQNET=y
BR2_PACKAGE_ALSA_UTILS_SPEAKER_TEST=y
BR2_PACKAGE_FFMPEG_NONFREE=y
BR2_PACKAGE_FFMPEG_FFPLAY=y
BR2_PACKAGE_FFMPEG_FFSERVER=y
BR2_PACKAGE_GST_FFMPEG=y
BR2_PACKAGE_GST_DSP=y
BR2_PACKAGE_GST_OMAPFB=y
BR2_PACKAGE_GST_PLUGINS_GOOD=y
BR2_PACKAGE_GST_PLUGINS_GOOD_PLUGIN_V4L2=y
BR2_PACKAGE_GST_PLUGINS_BAD=y
BR2_PACKAGE_GST_PLUGINS_BAD_PLUGIN_CAMERABIN=y
BR2_PACKAGE_GST_PLUGINS_BAD_PLUGIN_CAMERABIN2=y
BR2_PACKAGE_GST_PLUGINS_BAD_PLUGIN_DIRECTFB=y
BR2_PACKAGE_MPG123=y
BR2_PACKAGE_MPLAYER=y
BR2_PACKAGE_BZIP2=y
BR2_PACKAGE_GZIP=y
BR2_PACKAGE_OPROFILE=y
BR2_PACKAGE_VALGRIND=y
BR2_PACKAGE_TAR=y
BR2_PACKAGE_DIRECTFB=y
BR2_PACKAGE_DIRECTB_TESTS=y
BR2_PACKAGE_I2C_TOOLS=y
BR2_PACKAGE_LIBV4L_V4L2_COMPLIANCE=y
BR2_PACKAGE_LIBV4L_V4L2_DBG=y
BR2_PACKAGE_MEDIA_CTL=y
BR2_PACKAGE_YAVTA=y
BR2_PACKAGE_OPENSSL_BIN=y
BR2_PACKAGE_SQLITE=y
BR2_PACKAGE_SQLITE_READLINE=y
BR2_PACKAGE_LIBCONFIG=y
BR2_PACKAGE_OPENCV=y
BR2_PACKAGE_OPENCV_BUILD_TESTS=y
BR2_PACKAGE_OPENCV_INSTALL_DATA=y
BR2_PACKAGE_OPENCV_WITH_FFMPEG=y
BR2_PACKAGE_OPENCV_WITH_GSTREAMER=y
BR2_PACKAGE_OPENCV_WITH_JPEG=y
BR2_PACKAGE_OPENCV_WITH_PNG=y
BR2_PACKAGE_OPENCV_WITH_TIFF=y
BR2_PACKAGE_OPENCV_WITH_V4L=y
BR2_PACKAGE_CAN_UTILS=y
BR2_PACKAGE_EMAIL=y
BR2_PACKAGE_IPERF=y
BR2_PACKAGE_NETCAT=y
BR2_PACKAGE_OPENSSH=y
BR2_PACKAGE_PORTMAP=y
BR2_PACKAGE_TCPDUMP=y
BR2_PACKAGE_BASH=y
BR2_PACKAGE_LOGROTATE=y
BR2_PACKAGE_MC=y
BR2_PACKAGE_MONIT=y
BR2_PACKAGE_SCREEN=y
BR2_PACKAGE_MODULE_INIT_TOOLS=y
BR2_PACKAGE_DSP_TOOLS=y
BR2_PACKAGE_NANO=y
BR2_PACKAGE_VIM=y
BR2_TARGET_UBOOT=y
BR2_TARGET_UBOOT_BOARDNAME="omap3_beagle"
BR2_TARGET_UBOOT_EXTRAVERSION="-mg01.1"
BR2_TARGET_UBOOT_FORMAT_IMG=y
BR2_TARGET_UBOOT_SPL=y
BR2_TARGET_UBOOT_UENV_PARAMETERS=y
BR2_LINUX_KERNEL=y
BR2_LINUX_KERNEL_PATCH="board/beagleboard/xm/kernel-patches/"
BR2_LINUX_KERNEL_USE_CUSTOM_CONFIG=y
BR2_LINUX_KERNEL_CUSTOM_CONFIG_FILE="board/beagleboard/xm/linux-3.2.8.config"
```

## configs/omap3_beagle_defconfig
```kconfig
# Architecture
BR2_arm=y
BR2_cortex_a8=y

# Toolchain
BR2_TOOLCHAIN_EXTERNAL=y
# BR2_TOOLCHAIN_EXTERNAL_DOWNLOAD is not set
BR2_TOOLCHAIN_EXTERNAL_CODESOURCERY_ARM201103=y
BR2_TOOLCHAIN_EXTERNAL_PATH="/opt/CodeSourcery"
BR2_TOOLCHAIN_EXTERNAL_PREFIX="arm-none-linux-gnueabi"
BR2_TOOLCHAIN_EXTERNAL_GLIBC=y
# BR2_PREFER_SOFT_FLOAT is not set
# BR2_SOFT_FLOAT is not set
BR2_TARGET_OPTIMIZATION="-pipe -mfpu=neon -ftree-vectorize -mfloat-abi=softfp"

# Serial port
BR2_TARGET_GENERIC_GETTY_PORT="ttyO2"
```

## package/email/Config.in
```kconfig
config BR2_PACKAGE_EMAIL
	bool "email"
	help
	  Email is a program for the Unix environment that sends messages.

	  http://www.cleancode.org/projects/email
```

## package/mc/Config.in
```kconfig
config BR2_PACKAGE_MC
	bool "mc"
	select BR2_PACKAGE_NCURSES
	help
	  GNU Midnight Commander is a visual file manager, licensed under 
	  GNU General Public License and therefore qualifies as Free Software. 
	  It's a feature rich full-screen text mode application that allows 
	  you to copy, move and delete files and whole directory trees, search 
	  for files and run commands in the subshell. Internal viewer and 
	  editor are included.

	  http://www.midnight-commander.org/
```

## package/media-ctl/Config.in
```kconfig
config BR2_PACKAGE_MEDIA_CTL
    bool "media-ctl"
    help
        Media controller control application
```

## package/opencv/Config.in
```kconfig
config BR2_PACKAGE_OPENCV
	bool "opencv"
	help
	  OpenCV (Open Source Computer Vision) is a library of programming 
	  functions for real time computer vision.

	  http://opencv.willowgarage.com/

config BR2_PACKAGE_OPENCV_JPEG
	bool "JPEG support"
	depends on BR2_PACKAGE_OPENCV
	select BR2_PACKAGE_JPEG
	help
	  Enable JPEG library support for OpenCV.

config BR2_PACKAGE_OPENCV_TIFF
	bool "TIFF support"
	depends on BR2_PACKAGE_OPENCV
	select BR2_PACKAGE_TIFF
	help
	  Enable TIFF library support for OpenCV.

config BR2_PACKAGE_OPENCV_LIBPNG
	bool "PNG support"
	depends on BR2_PACKAGE_OPENCV
	select BR2_PACKAGE_LIBPNG
	help
	  Enable PNG library support for OpenCV.

config BR2_PACKAGE_OPENCV_QT
	bool "Qt Framework support"
	depends on BR2_PACKAGE_OPENCV
	depends on BR2_PACKAGE_QT
	help
	  Enable Qt framework support for OpenCV. This requires Qt framework.

comment "OpenCV Qt support depends on Qt framework"
	depends on BR2_PACKAGE_OPENCV
	depends on !BR2_PACKAGE_QT

config BR2_PACKAGE_OPENCV_FFMPEG
	bool "FFmpeg support"
	depends on BR2_PACKAGE_OPENCV
	depends on BR2_PACKAGE_FFMPEG
	help
	  Enable FFmpeg support for OpenCV. This requires FFmpeg.

comment "OpenCV FFmpeg support depends on FFmpeg"
	depends on BR2_PACKAGE_OPENCV
	depends on !BR2_PACKAGE_FFMPEG

config BR2_PACKAGE_OPENCV_GSTREAMER
	bool "GStreamer support"
	depends on BR2_PACKAGE_OPENCV
	depends on BR2_PACKAGE_GSTREAMER
	help
	  Enable GStreamer framework support for OpenCV. This requires
	  GStreamer framework.

comment "OpenCV GStreamer support depends on GStreamer framework"
	depends on BR2_PACKAGE_OPENCV
	depends on !BR2_PACKAGE_GSTREAMER

config BR2_PACKAGE_OPENCV_LIBGTK2
	bool "GTK+ 2 support"
	depends on BR2_PACKAGE_OPENCV
	depends on BR2_PACKAGE_LIBGTK2
	help
	  Enable GTK+ 2 GUI library support for OpenCV. This requires 
	  GTK+ 2 GUI library.

comment "OpenCV GTK+ 2 support depends on GTK+ 2"
	depends on BR2_PACKAGE_OPENCV
	depends on !BR2_PACKAGE_LIBGTK2

config BR2_PACKAGE_OPENCV_LIBV4L
	bool "V4L support"
	depends on BR2_PACKAGE_OPENCV
	depends on BR2_PACKAGE_LIBV4L
	help
	  Enable V4L (v4l2 - video for linux 2) support for OpenCV. 
	  This requires V4L library.

comment "OpenCV V4L support depends on V4L library"
	depends on BR2_PACKAGE_OPENCV
	depends on !BR2_PACKAGE_LIBV4L

config BR2_PACKAGE_OPENCV_PYTON
	bool "Python language support"
	depends on BR2_PACKAGE_OPENCV
	depends on BR2_PACKAGE_PYTHON
	help
	  Enable python language interpreter support for OpenCV.
	  This requires python language interpreter.

comment "OpenCV python support depends on python"
	depends on BR2_PACKAGE_OPENCV
	depends on !BR2_PACKAGE_PYTHON
```

## package/valgrind/Config.in
```kconfig
config BR2_PACKAGE_VALGRIND
	bool "valgrind"
	depends on BR2_i386 || BR2_x86_64 || BR2_arm
	help
	  Tool for debugging and profiling Linux programs.

	  http://valgrind.kde.org/
```
